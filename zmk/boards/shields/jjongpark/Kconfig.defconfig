## zmk/boards/shields/jjongpark/Kconfig.defconfig
```kconfig
if SHIELD_JJONGPARK_LEFT

# Name must be less than 16 characters long!
config ZMK_KEYBOARD_NAME
    default "jjongpark"

config ZMK_SPLIT_ROLE_CENTRAL
    default y

endif

if SHIELD_JJONGPARK_LEFT || SHIELD_JJONGPARK_RIGHT

config ZMK_SPLIT
    default y

endif
```

## zmk/boards/shields/jjongpark/Kconfig.shield
```kconfig
# No whitespace after the comma or in your part name!
config SHIELD_JJONGPARK_LEFT
    def_bool $(shields_list_contains,jjongpark_left)

# No whitespace after the comma or in your part name!
config SHIELD_JJONGPARK_RIGHT
    def_bool $(shields_list_contains,jjongpark_right)
```
